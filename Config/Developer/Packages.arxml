AUTOSAR XML (schema 4-3-0)
package /EndToEndProtections
  end to end protection set EndToEndProtectionSet
