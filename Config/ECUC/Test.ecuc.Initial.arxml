AUTOSAR XML (schema 4-3-0)
package /InitialEcuC
  ecuc value collection InitialEcuC: ecuc-values=[Dcm, Dem]
  module config Dcm
    DcmConfigSet  # Diagnostics Data Import
      DcmDsp: DcmDspMaxDidToRead=5  # Diagnostics Data Import
        DcmDspSession  # Diagnostics Data Import
          3 x DcmDspSessionRow, all with DcmDspSessionP2ServerMax=0.05, DcmDspSessionP2StarServerMax=5:
            Extended: DcmDspSessionLevel=3  # Diagnostics Data Import
            Programming: DcmDspSessionLevel=2  # Diagnostics Data Import
            Default: DcmDspSessionLevel=1  # Diagnostics Data Import
        DcmDspSecurity  # Diagnostics Data Import
          Level_01 (DcmDspSecurityRow):  # Diagnostics Data Import
            DcmDspSecurityDelayTime = 10
            DcmDspSecurityDelayTimeOnBoot = 0
            DcmDspSecurityKeySize = 2
            DcmDspSecurityLevel = 1
            DcmDspSecurityNumAttDelay = 3
            DcmDspSecuritySeedSize = 2
          Locked (DcmDspSecurityRow): DcmDspSecurityLevel=0  # Diagnostics Data Import
        DcmDspControlDTCSetting: DcmSupportDTCSettingControlOptionRecord=true  # Diagnostics Data Import
        DidInfo_Diag_RWDI_LightOnOffCounter (DcmDspDidInfo)  # Diagnostics Data Import
          DcmDspDidAccess  # Diagnostics Data Import
            DcmDspDidWrite  # Diagnostics Data Import
            DcmDspDidRead  # Diagnostics Data Import
        Diag_RWDI_LightOnOffCounter (DcmDspDid): DcmDspDidIdentifier=4096, DcmDspDidInfoRef=DidInfo_Diag_RWDI_LightOnOffCounter  # Diagnostics Data Import
          LightOnOffCounter_Value (DcmDspDidSignal): DcmDspDidDataPos=0, DcmDspDidDataRef=Diag_RWDI_LightOnOffCounter_LightOnOffCounter_Value  # Diagnostics Data Import
        DataInfo_Diag_RWDI_LightOnOffCounter_LightOnOffCounter_Value (DcmDspDataInfo): DcmDspDataFixedLength=true  # Diagnostics Data Import
        Diag_RWDI_LightOnOffCounter_LightOnOffCounter_Value (DcmDspData): DcmDspDataSize=32, DcmDspDataType=UINT32, DcmDspDataInfoRef=DataInfo_Diag_RWDI_LightOnOffCounter_LightOnOffCounter_Value  # Diagnostics Data Import
      DcmDsd  # Diagnostics Data Import
        DcmDsdServiceTable  # Diagnostics Data Import
          9 x DcmDsdService:
            ControlDtcSetting: DcmDsdSidTabServiceId=133, DcmDsdSidTabSubfuncAvail=true  # Diagnostics Data Import
              Disable (DcmDsdSubService): DcmDsdSubServiceId=2  # Diagnostics Data Import
              Enable (DcmDsdSubService): DcmDsdSubServiceId=1  # Diagnostics Data Import
            TesterPresent: DcmDsdSidTabServiceId=62, DcmDsdSidTabSubfuncAvail=true  # Diagnostics Data Import
              TesterPresent (DcmDsdSubService): DcmDsdSubServiceId=0  # Diagnostics Data Import
            WriteDataById: DcmDsdSidTabServiceId=46, DcmDsdSidTabSubfuncAvail=false  # Diagnostics Data Import
            SecurityAccess: DcmDsdSidTabServiceId=39, DcmDsdSidTabSubfuncAvail=true, DcmDsdSidTabSessionLevelRef=DcmDspSession/Programming, DcmDsdSidTabSessionLevelRef=DcmDspSession/Extended  # Diagnostics Data Import
              Level1_1_Send (DcmDsdSubService): DcmDsdSubServiceId=2, DcmDsdSubServiceSessionLevelRef=DcmDspSession/Programming, DcmDsdSubServiceSessionLevelRef=DcmDspSession/Extended  # Diagnostics Data Import
              Seed_Level1_Request (DcmDsdSubService): DcmDsdSubServiceId=1, DcmDsdSubServiceSessionLevelRef=DcmDspSession/Programming, DcmDsdSubServiceSessionLevelRef=DcmDspSession/Extended  # Diagnostics Data Import
            ReadDataById: DcmDsdSidTabServiceId=34, DcmDsdSidTabSubfuncAvail=false  # Diagnostics Data Import
            ReadDtcInfo: DcmDsdSidTabServiceId=25, DcmDsdSidTabSubfuncAvail=true  # Diagnostics Data Import
              3 x DcmDsdSubService:
                RDTCEDRBDN: DcmDsdSubServiceId=6  # Diagnostics Data Import
                RNODTCBSM: DcmDsdSubServiceId=1  # Diagnostics Data Import
                RDTCBSM: DcmDsdSubServiceId=2  # Diagnostics Data Import
            ClearDiagInfo: DcmDsdSidTabServiceId=20, DcmDsdSidTabSubfuncAvail=false  # Diagnostics Data Import
            EcuReset: DcmDsdSidTabServiceId=17, DcmDsdSidTabSubfuncAvail=true  # Diagnostics Data Import
              Hard (DcmDsdSubService): DcmDsdSubServiceId=1  # Diagnostics Data Import
            DiagSessionControl: DcmDsdSidTabServiceId=16, DcmDsdSidTabSubfuncAvail=true  # Diagnostics Data Import
              3 x DcmDsdSubService:
                Extended: DcmDsdSubServiceId=3  # Diagnostics Data Import
                Programming: DcmDsdSubServiceId=2, DcmDsdSubServiceSessionLevelRef=DcmDspSession/Programming, DcmDsdSubServiceSessionLevelRef=DcmDspSession/Extended  # Diagnostics Data Import
                Default: DcmDsdSubServiceId=1  # Diagnostics Data Import
  module config Dem
    DemGeneral:  # Diagnostics Data Import
      DemAgingCycleCounterProcessing = DEM_PROCESS_AGINGCTR_INTERN
      DemDebounceCounterBasedSupport = true
      DemDtcStatusAvailabilityMask = 121
      DemMaxNumberEventEntryMirror = 0
      DemPTOSupport = false
      DemTypeOfFreezeFrameRecordNumeration = DEM_FF_RECNUM_CALCULATED
      OdometerValue_OdometerValue (DemDataClass):  # Diagnostics Data Import
        DemDataElementDataSize = 4
        DemDataElementDataType = UINT32
        DemDataElementEndianness = LITTLE_ENDIAN
        DemDataElementUsePort = USE_DATA_CLIENT_SERVER_PORT
        DemDataElementStoreNonVolatile = true
      OccurrenceCounter_OccurenceCounter (DemDataClass):  # Diagnostics Data Import
        DemDataElementDataSize = 4
        DemDataElementDataType = UINT32
        DemDataElementEndianness = LITTLE_ENDIAN
        DemDataElementUsePort = USE_DATA_CLIENT_SERVER_PORT
        DemDataElementStoreNonVolatile = true
      PowerCycle (DemOperationCycle): DemOperationCycleType=DEM_OPCYC_POWER  # Diagnostics Data Import
      IgnitionCycle (DemOperationCycle): DemOperationCycleType=DEM_OPCYC_IGNITION  # Diagnostics Data Import
      OdometerValue (DemExtendedDataRecordClass): DemExtendedDataRecordNumber=2, DemDataClassRef=OdometerValue_OdometerValue  # Diagnostics Data Import
      OccurrenceCounter (DemExtendedDataRecordClass): DemExtendedDataRecordNumber=1, DemDataClassRef=OccurrenceCounter_OccurenceCounter  # Diagnostics Data Import
      ExtendedDataClass_4f5344cd (DemExtendedDataClass): DemExtendedDataRecordClassRef=OccurrenceCounter, DemExtendedDataRecordClassRef=OdometerValue  # Diagnostics Data Import
    DemConfigSet  # Diagnostics Data Import
      DTC_0x000002 (DemEventParameter): DemEventKind=DEM_EVENT_KIND_SWC, DemDTCClassRef=DTCClass_DTC_0x000002, DemExtendedDataClassRef=ExtendedDataClass_4f5344cd  # Diagnostics Data Import
        DemEventClass:  # Diagnostics Data Import
          DemAgingAllowed = false
          DemAgingCycleCounterThreshold = 1
          DemEventDestination = DEM_DTC_ORIGIN_PRIMARY_MEMORY
          DemEventPriority = 2
          DemAgingCycleRef = IgnitionCycle
          DemOperationCycleRef = IgnitionCycle
          DemDebounceAlgorithmClass  # Diagnostics Data Import
            DemDebounceCounterBased: DemDebounceCounterDecrementStepSize=1, DemDebounceCounterIncrementStepSize=1, DemDebounceCounterJumpDown=false, DemDebounceCounterJumpUp=true  # Diagnostics Data Import
      DTCClass_DTC_0x000002 (DemDTCClass): DemUdsDTC=2  # Diagnostics Data Import
